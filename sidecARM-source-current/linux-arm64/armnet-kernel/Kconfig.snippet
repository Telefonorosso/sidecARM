## sidecARM-source-current/linux-arm64/armnet-kernel/Kconfig.snippet
```kconfig
config ARMNET
	tristate "PiStorm/Emu68 ARM-Amiga shared-RAM Ethernet"
	depends on OF
	help
	  Normal Ethernet interface arm0 backed by shared service RAM.
	  It exchanges Ethernet frames with AmigaOS armnet.device.
```

## sidecARM-source-current/linux-arm64/armterm-kernel/Kconfig.snippet
```kconfig
config ARMTERM
	bool "PiStorm/Emu68 shared-RAM TTY"
	depends on TTY
	default n
	help
	  Exposes /dev/armterm over reserved shared service RAM.
```

## sidecARM-source-minimal-20260904/linux-arm64/armblk-kernel/Kconfig.snippet
```kconfig
config ARMBLK
	tristate "PiStorm/Emu68 ARM-Amiga shared-RAM block device"
	depends on OF && BLOCK
	help
	  Expose an AmigaOS-hosted image file as /dev/armblk0 through
	  the Emu68 ARM-service shared RAM transport.
```

## sidecARM-source-minimal-20260904/linux-arm64/armfb-kernel/Kconfig.snippet
```kconfig
config FB_ARMFB
	bool "PiStorm/Emu68 shared-RAM framebuffer"
	depends on FB && OF
	select FB_SYSMEM_HELPERS
	default n
	help
	  Exposes an Emu68 shared-memory region as /dev/fb0 for the
	  sidecARM Linux service. The initial mode is 800x600 RGB565.
```
